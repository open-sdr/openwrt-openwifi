## target/linux/zynq/image/Config.in
```kconfig
config ZYNQ_BITSTREAM_BOOTFS
    bool "Copy bitstream to boot partition"
    default n
    depends on TARGET_zynq

config HAS_OVERLAYS_BOOTFS
    bool "Target has overlays for the boot partition"
    default n
    depends on TARGET_zynq
```

## target/linux/zynqmp/image/Config.in
```kconfig
config ZYNQMP_BITSTREAM_BOOTFS
    bool "Copy bitstream to boot partition"
    default n
    depends on TARGET_zynqmp

config HAS_OVERLAYS_BOOTFS
    bool "Target has overlays for the boot partition"
    default n
    depends on TARGET_zynqmp
```
